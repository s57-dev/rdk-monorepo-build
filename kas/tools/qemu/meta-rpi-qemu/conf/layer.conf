## kas/tools/qemu/meta-rpi-qemu/conf/layer.conf
```bitbake
# Minimal BSP overlay layer that adds QEMU/virtio support to the
# Raspberry Pi 4 kernel and guest graphics stack.

# We give this layer a low priority so it only provides additive
# bbappends and never overrides recipes from the vendor layers.

BBPATH .= ":${LAYERDIR}"
BBFILES += "${LAYERDIR}/recipes-*/*/*.bb \
            ${LAYERDIR}/recipes-*/*/*.bbappend"
BBFILE_COLLECTIONS += "meta-rpi-qemu"
BBFILE_PATTERN_meta-rpi-qemu = "^${LAYERDIR}/"
BBFILE_PRIORITY_meta-rpi-qemu = "10"

LAYERDEPENDS_meta-rpi-qemu = "core raspberrypi"
LAYERSERIES_COMPAT_meta-rpi-qemu = "kirkstone scarthgap"
```

## meta-rdk-optional/conf/layer.conf
```bitbake
# We have a conf and classes directory, add to BBPATH
BBPATH .= ":${LAYERDIR}"

# We have recipes-* directories, add to BBFILES
BBFILES += "${LAYERDIR}/recipes-*/*/*.bb \
            ${LAYERDIR}/recipes-*/*/*.bbappend"

BBFILE_COLLECTIONS += "rdk-optional"
BBFILE_PATTERN_rdk-optional := "^${LAYERDIR}/"
BBFILE_PRIORITY_rdk-optional = "8"

LAYERDEPENDS_rdk-optional = "core swupdate"
LAYERSERIES_COMPAT_rdk-optional = "kirkstone"
```

## meta-rdk-optional/wic/sdimage-raspberrypi-ab.wks
```
# short-description: Create Raspberry Pi SD card image with A/B rootfs slots
# long-description: Creates a partitioned SD card image with one boot partition
# and two rootfs partitions (slot A and slot B) for SWUpdate-based A/B updates.

part /boot --source bootimg-partition --ondisk mmcblk0 --fstype=vfat --label boot --active --align 4096 --size 64
part / --source rootfs --ondisk mmcblk0 --fstype=ext4 --label rootfsA --align 4096 --size 4096
part /altroot --source rootfs --ondisk mmcblk0 --fstype=ext4 --label rootfsB --align 4096 --size 4096
part /data --ondisk mmcblk0 --fstype=ext4 --label data --align 4096 --size 1024
```
